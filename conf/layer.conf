## conf/layer.conf
```bitbake
# We have a conf and classes directory, add to BBPATH
BBPATH .= ":${LAYERDIR}"

# We have recipes-* directories, add to BBFILES
BBFILES += "${LAYERDIR}/recipes-*/*/*.bb \
            ${LAYERDIR}/recipes-*/*/*.bbappend"

BBFILE_COLLECTIONS += "meta-motorknob"
BBFILE_PATTERN_meta-motorknob = "^${LAYERDIR}/"
BBFILE_PRIORITY_meta-motorknob = "6"

LAYERDEPENDS_meta-motorknob = "core"
LAYERSERIES_COMPAT_meta-motorknob = "scarthgap"
```
